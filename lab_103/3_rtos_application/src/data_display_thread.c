/*
 * data_display_thread.c
 *
 * this is a thread that pulls the data generated by another thread from a
 * mail queue and then displays it in a terminal
 *
 * author:    Dr. Alex Shenfield
 * date:      06/09/2017
 * purpose:   55-604481 embedded computer networks : lab 103
 */

// include cmsis_os for the rtos api and the stdio package for printing
#include "cmsis_os.h"
#include <stdio.h>

// include main.h (this is where we initialise the mail type)
#include "main.h"

// include the shu bsp libraries for the stm32f7 discovery board and the serial
// configuration files
#include "pinmappings.h"
#include "clock.h"
#include "serial.h"
#include "gpio.h"
#include "stm32746g_discovery_lcd.h"
#include "stm32746g_discovery_sdram.h"
#include "stm32f7xx_hal.h"

// RTOS DEFINES


// Hardware Defines
//gpio_pin_t led1 = {PI_1, GPIOI, GPIO_PIN_1};
//gpio_pin_t led2 = {PF_6, GPIOF, GPIO_PIN_6};
//gpio_pin_t led3 = {PF_7, GPIOF, GPIO_PIN_7};
//gpio_pin_t led4 = {PF_8, GPIOF, GPIO_PIN_8};

// declare the thread function prototypes, thread id, and priority
void display_thread(void const *argument);
osThreadId tid_display_thread;
osThreadDef(display_thread, osPriorityNormal, 1, 0);

// the mailbox we are pulling data from is declared elsewhere ...
extern osMailQId mail_box;

// THREAD INITIALISATION

// create the data display thread
int init_display_thread(void)
{
	//Init LEDs
	//init_gpio(led1, OUTPUT);
	//init_gpio(led2, OUTPUT);
  //init_gpio(led3, OUTPUT);
	//init_gpio(led4, OUTPUT);
	
	// initialise the lcd
  BSP_LCD_Init();
  BSP_LCD_LayerDefaultInit(LTDC_ACTIVE_LAYER, SDRAM_DEVICE_ADDR);
  BSP_LCD_SelectLayer(LTDC_ACTIVE_LAYER);

  // set the background colour to blue and clear the lcd
  BSP_LCD_SetBackColor(LCD_COLOR_BROWN);
  BSP_LCD_Clear(LCD_COLOR_BROWN);
  
  // set the font to use
  BSP_LCD_SetFont(&Font24); 
	BSP_LCD_SetTextColor(LCD_COLOR_GREEN);
	
  // initialize peripherals (i.e. the uart) here
  init_uart(9600);
  printf("display thread up and running ...\r\n");

  // create the thread and get its task id
  tid_display_thread = osThreadCreate(osThread(display_thread), NULL);

  // check if everything worked ...
  if(!tid_display_thread)
  {
    return(-1);
  }
  return(0);
}

// ACTUAL THREADS

// data display thread - pull the data out of the mail queue and print it to
// the uart
void display_thread(void const *argument)
{
  // infinite loop getting out fake data ...
  while(1)
  {
    // get the data ...
    osEvent evt = osMailGet(mail_box, osWaitForever);
    if(evt.status == osEventMail)
    {
      mail_t *mail = (mail_t*)evt.value.p;
			
			//Print Temp to LCD
			char str1[28];
			sprintf(str1, "Temperature = %6.2f'C     ", mail->tempVal);
			BSP_LCD_DisplayStringAtLine(1, (uint8_t *)str1);
			
			//Print Luminosity
			
			char str2[28];
			sprintf(str2, "Luminosity = %4d          ", mail->ldrVal);
			BSP_LCD_DisplayStringAtLine(2, (uint8_t *)str2);
			
			//redefine value to pixel range
			uint16_t ldrBar = (mail->ldrVal * 479) / 100.0;
			BSP_LCD_SetTextColor(LCD_COLOR_BROWN);
			BSP_LCD_FillRect(0, 74, 480, 20);
			
			BSP_LCD_SetTextColor(LCD_COLOR_GREEN);
			BSP_LCD_FillRect(0, 74, ldrBar, 20);
			
			//Print Potentiometer			
			char str3[28];
			sprintf(str3, "Potentiometer = %4d       ", mail->potVal);
			BSP_LCD_DisplayStringAtLine(4, (uint8_t *)str3);
			
			//redine value to pixels
			uint16_t potBar = (mail->potVal * 479) / 100.0;
			BSP_LCD_SetTextColor(LCD_COLOR_BROWN);
			BSP_LCD_FillRect(0, 122, 480, 20);
			BSP_LCD_SetTextColor(LCD_COLOR_GREEN);
			BSP_LCD_FillRect(0, 122, potBar, 20);
						
      osMailFree(mail_box, mail);
    }
  }
}
 
